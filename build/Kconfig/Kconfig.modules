## build/Kconfig/soc/Kconfig
```kconfig
# Load Zephyr SoC Kconfig descriptions.
osource "/Users/dmitrymedvedev/ncs-workspace/zephyr/soc/xlnx/zynqmp/Kconfig"
osource "/Users/dmitrymedvedev/ncs-workspace/zephyr/soc/xlnx/zynq7000/Kconfig"
osource "/Users/dmitrymedvedev/ncs-workspace/zephyr/soc/xen/Kconfig"
osource "/Users/dmitrymedvedev/ncs-workspace/zephyr/soc/wch/ch32v00x/Kconfig"
osource "/Users/dmitrymedvedev/ncs-workspace/zephyr/soc/ti/simplelink/Kconfig"
osource "/Users/dmitrymedvedev/ncs-workspace/zephyr/soc/ti/lm3s6965/Kconfig"
osource "/Users/dmitrymedvedev/ncs-workspace/zephyr/soc/ti/k3/Kconfig"
osource "/Users/dmitrymedvedev/ncs-workspace/zephyr/soc/telink/tlsr/Kconfig"
osource "/Users/dmitrymedvedev/ncs-workspace/zephyr/soc/starfive/jh71xx/Kconfig"
osource "/Users/dmitrymedvedev/ncs-workspace/zephyr/soc/st/stm32/Kconfig"
osource "/Users/dmitrymedvedev/ncs-workspace/zephyr/soc/snps/qemu_arc/Kconfig"
osource "/Users/dmitrymedvedev/ncs-workspace/zephyr/soc/snps/nsim/arc_v/Kconfig"
osource "/Users/dmitrymedvedev/ncs-workspace/zephyr/soc/snps/nsim/arc_classic/Kconfig"
osource "/Users/dmitrymedvedev/ncs-workspace/zephyr/soc/snps/hsdk4xd/Kconfig"
osource "/Users/dmitrymedvedev/ncs-workspace/zephyr/soc/snps/hsdk/Kconfig"
osource "/Users/dmitrymedvedev/ncs-workspace/zephyr/soc/snps/emsk/Kconfig"
osource "/Users/dmitrymedvedev/ncs-workspace/zephyr/soc/snps/emsdp/Kconfig"
osource "/Users/dmitrymedvedev/ncs-workspace/zephyr/soc/snps/arc_iot/Kconfig"
osource "/Users/dmitrymedvedev/ncs-workspace/zephyr/soc/silabs/Kconfig"
osource "/Users/dmitrymedvedev/ncs-workspace/zephyr/soc/sifive/sifive_freedom/Kconfig"
osource "/Users/dmitrymedvedev/ncs-workspace/zephyr/soc/sensry/Kconfig"
osource "/Users/dmitrymedvedev/ncs-workspace/zephyr/soc/rockchip/Kconfig"
osource "/Users/dmitrymedvedev/ncs-workspace/zephyr/soc/renode/riscv_virtual/Kconfig"
osource "/Users/dmitrymedvedev/ncs-workspace/zephyr/soc/renode/cortex_r8_virtual/Kconfig"
osource "/Users/dmitrymedvedev/ncs-workspace/zephyr/soc/renesas/smartbond/Kconfig"
osource "/Users/dmitrymedvedev/ncs-workspace/zephyr/soc/renesas/rzt2m/Kconfig"
osource "/Users/dmitrymedvedev/ncs-workspace/zephyr/soc/renesas/rz/Kconfig"
osource "/Users/dmitrymedvedev/ncs-workspace/zephyr/soc/renesas/rcar/Kconfig"
osource "/Users/dmitrymedvedev/ncs-workspace/zephyr/soc/renesas/ra/Kconfig"
osource "/Users/dmitrymedvedev/ncs-workspace/zephyr/soc/realtek/ec/Kconfig"
osource "/Users/dmitrymedvedev/ncs-workspace/zephyr/soc/raspberrypi/rpi_pico/Kconfig"
osource "/Users/dmitrymedvedev/ncs-workspace/zephyr/soc/quicklogic/eos_s3/Kconfig"
osource "/Users/dmitrymedvedev/ncs-workspace/zephyr/soc/qemu/virt_riscv/Kconfig"
osource "/Users/dmitrymedvedev/ncs-workspace/zephyr/soc/qemu/malta/Kconfig"
osource "/Users/dmitrymedvedev/ncs-workspace/zephyr/soc/openisa/rv32m1/Kconfig"
osource "/Users/dmitrymedvedev/ncs-workspace/zephyr/soc/nxp/s32/Kconfig"
osource "/Users/dmitrymedvedev/ncs-workspace/zephyr/soc/nxp/rw/Kconfig"
osource "/Users/dmitrymedvedev/ncs-workspace/zephyr/soc/nxp/mcx/Kconfig"
osource "/Users/dmitrymedvedev/ncs-workspace/zephyr/soc/nxp/lpc/Kconfig"
osource "/Users/dmitrymedvedev/ncs-workspace/zephyr/soc/nxp/layerscape/Kconfig"
osource "/Users/dmitrymedvedev/ncs-workspace/zephyr/soc/nxp/kinetis/Kconfig"
osource "/Users/dmitrymedvedev/ncs-workspace/zephyr/soc/nxp/imxrt/Kconfig"
osource "/Users/dmitrymedvedev/ncs-workspace/zephyr/soc/nxp/imx/Kconfig"
osource "/Users/dmitrymedvedev/ncs-workspace/zephyr/soc/nuvoton/numicro/Kconfig"
osource "/Users/dmitrymedvedev/ncs-workspace/zephyr/soc/nuvoton/numaker/Kconfig"
osource "/Users/dmitrymedvedev/ncs-workspace/zephyr/soc/nuvoton/npcx/Kconfig"
osource "/Users/dmitrymedvedev/ncs-workspace/zephyr/soc/nuvoton/npcm/Kconfig"
osource "/Users/dmitrymedvedev/ncs-workspace/zephyr/soc/nordic/Kconfig"
osource "/Users/dmitrymedvedev/ncs-workspace/zephyr/soc/neorv32/Kconfig"
osource "/Users/dmitrymedvedev/ncs-workspace/zephyr/soc/native/inf_clock/Kconfig"
osource "/Users/dmitrymedvedev/ncs-workspace/zephyr/soc/microchip/miv/Kconfig"
osource "/Users/dmitrymedvedev/ncs-workspace/zephyr/soc/microchip/mec/Kconfig"
osource "/Users/dmitrymedvedev/ncs-workspace/zephyr/soc/mediatek/mt8xxx/Kconfig"
osource "/Users/dmitrymedvedev/ncs-workspace/zephyr/soc/lowrisc/opentitan/Kconfig"
osource "/Users/dmitrymedvedev/ncs-workspace/zephyr/soc/litex/litex_vexriscv/Kconfig"
osource "/Users/dmitrymedvedev/ncs-workspace/zephyr/soc/ite/ec/Kconfig"
osource "/Users/dmitrymedvedev/ncs-workspace/zephyr/soc/intel/raptor_lake/Kconfig"
osource "/Users/dmitrymedvedev/ncs-workspace/zephyr/soc/intel/lakemont/Kconfig"
osource "/Users/dmitrymedvedev/ncs-workspace/zephyr/soc/intel/intel_socfpga_std/Kconfig"
osource "/Users/dmitrymedvedev/ncs-workspace/zephyr/soc/intel/intel_socfpga/Kconfig"
osource "/Users/dmitrymedvedev/ncs-workspace/zephyr/soc/intel/intel_niosv/Kconfig"
osource "/Users/dmitrymedvedev/ncs-workspace/zephyr/soc/intel/intel_ish/Kconfig"
osource "/Users/dmitrymedvedev/ncs-workspace/zephyr/soc/intel/intel_adsp/Kconfig"
osource "/Users/dmitrymedvedev/ncs-workspace/zephyr/soc/intel/elkhart_lake/Kconfig"
osource "/Users/dmitrymedvedev/ncs-workspace/zephyr/soc/intel/atom/Kconfig"
osource "/Users/dmitrymedvedev/ncs-workspace/zephyr/soc/intel/apollo_lake/Kconfig"
osource "/Users/dmitrymedvedev/ncs-workspace/zephyr/soc/intel/alder_lake/Kconfig"
osource "/Users/dmitrymedvedev/ncs-workspace/zephyr/soc/infineon/cat3/Kconfig"
osource "/Users/dmitrymedvedev/ncs-workspace/zephyr/soc/infineon/cat1b/Kconfig"
osource "/Users/dmitrymedvedev/ncs-workspace/zephyr/soc/infineon/cat1a/Kconfig"
osource "/Users/dmitrymedvedev/ncs-workspace/zephyr/soc/gd/gd32/Kconfig"
osource "/Users/dmitrymedvedev/ncs-workspace/zephyr/soc/gaisler/leon3/Kconfig"
osource "/Users/dmitrymedvedev/ncs-workspace/zephyr/soc/gaisler/gr716a/Kconfig"
osource "/Users/dmitrymedvedev/ncs-workspace/zephyr/soc/espressif/Kconfig"
osource "/Users/dmitrymedvedev/ncs-workspace/zephyr/soc/ene/kb1200/Kconfig"
osource "/Users/dmitrymedvedev/ncs-workspace/zephyr/soc/efinix/sapphire/Kconfig"
osource "/Users/dmitrymedvedev/ncs-workspace/zephyr/soc/cdns/xtensa_sample_controller/Kconfig"
osource "/Users/dmitrymedvedev/ncs-workspace/zephyr/soc/cdns/sample_controller32/Kconfig"
osource "/Users/dmitrymedvedev/ncs-workspace/zephyr/soc/cdns/dc233c/Kconfig"
osource "/Users/dmitrymedvedev/ncs-workspace/zephyr/soc/brcm/bcmvk/Kconfig"
osource "/Users/dmitrymedvedev/ncs-workspace/zephyr/soc/brcm/bcm2712/Kconfig"
osource "/Users/dmitrymedvedev/ncs-workspace/zephyr/soc/brcm/bcm2711/Kconfig"
osource "/Users/dmitrymedvedev/ncs-workspace/zephyr/soc/atmel/sam0/Kconfig"
osource "/Users/dmitrymedvedev/ncs-workspace/zephyr/soc/atmel/sam/Kconfig"
osource "/Users/dmitrymedvedev/ncs-workspace/zephyr/soc/aspeed/Kconfig"
osource "/Users/dmitrymedvedev/ncs-workspace/zephyr/soc/arm/Kconfig"
osource "/Users/dmitrymedvedev/ncs-workspace/zephyr/soc/arm/beetle/Kconfig"
osource "/Users/dmitrymedvedev/ncs-workspace/zephyr/soc/andestech/Kconfig"
osource "/Users/dmitrymedvedev/ncs-workspace/zephyr/soc/amd/acp_6_0/Kconfig"
osource "/Users/dmitrymedvedev/ncs-workspace/zephyr/soc/ambiq/Kconfig"
osource "/Users/dmitrymedvedev/ncs-workspace/zephyr/soc/altr/zephyr_nios2f/Kconfig"
osource "/Users/dmitrymedvedev/ncs-workspace/zephyr/soc/altr/qemu_nios2/Kconfig"
osource "/Users/dmitrymedvedev/ncs-workspace/zephyr/soc/adi/max32/Kconfig"
osource "/Users/dmitrymedvedev/ncs-workspace/nrf/soc/nordic/Kconfig"
```
